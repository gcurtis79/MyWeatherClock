#include <ArduinoJson.h>

DynamicJsonDocument doc(1024);

// Array that keeps low/high temperatures and icons for two days
int temp_now;
int temp_low;
int temp_high;
int icon_int;
int dUpdate = 99;
unsigned long next_weather_update = 0;
bool weather_get_error;
int sunset;
int sunrise;
bool parsed = false;

uint8_t weather_icons_a[] = {
    0x00, 0x00, 0x00, 0x00, 0x00, 0x00, 0x00, 0x20, 0x00, 0x00, 0x00, 0x00,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 0x00,
    0x00, 0x00, 0x00, 0x00, 0x00, 0x00, 0x00, 0x00, 0xff, 0xe0, 0x00, 0x00,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 0x00,
    0x00, 0x00, 0x00, 0x00, 0xff, 0xe0, 0x00, 0x00, 0x00, 0x00, 0x00, 0x00,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 0x00,
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    0x00, 0x00, 0x00, 0x00, 0x00, 0x00, 0x00, 0x00, 0x00, 0x00, 0x00, 0x00,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 0x00, 0x00};

uint8_t weather_icons_b[] = {
    0x00, 0x00, 0x00, 0x00, 0x00, 0x20, 0x00, 0x00, 0xff, 0xe0, 0x00, 0x00,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 0x00,
    0x00, 0x00, 0xff, 0xe0, 0x00, 0x00, 0x00, 0x00, 0x00, 0x00, 0x00, 0x00,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 0x00,
    0x00, 0x20, 0x00, 0x00, 0x00, 0x00, 0xff, 0xe0, 0xff, 0xe0, 0xff, 0xe0,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 0x00,
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    0x00, 0x00, 0x00, 0x00, 0x00, 0x00, 0x00, 0x00, 0x00, 0x00, 0x00, 0x00,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 0x00, 0x00};

const char *getSocketJSON()
{
  WiFiClient client;
  if (!client.connect(HOST, HTTPPORT))
  {
    Serial.println("Connection failed");
    return "1";
  }
  client.print(String("GET ") + URL + " HTTP/1.1\r\n" +
               "Host: " + HOST + "\r\n" +
               "User-Agent: ESP Weather Clock\r\n" +
               "Connection: close\r\n\r\n");
  while (client.connected())
  {
    String line = client.readStringUntil('\n');
    if (line == "\r")
    {
      //Serial.println("Waiting for current weather data.");
      break;
    }
  }
  String reply = client.readStringUntil('\n');
  //Serial.println(reply);
  return reply.c_str();
}

void drawTemp(int x, int y, int temp, uint16_t color, int c_tail = 0)
{
  display.setTextColor(color);
  int dOffset = (x + intLength(temp) + 1);
  display.setCursor(x, (y + 4));
  display.printf("%d", temp);
  if (c_tail)
  {
    display.print(char(c_tail));
  }
}

bool update_weather()
{
  parsed = false;
  while (!parsed)
  {
    const char *json = getSocketJSON();
    Serial.printf("Recieved: %s\n", json);
    DeserializationError error = deserializeJson(doc, json);
    if (!error)
    {
      parsed = true;
    }
    else
    {
      Serial.printf("Error: %s\n", error.c_str());
    }
  }
  JsonObject sys = doc["sys"];
  sunset = sys["sunset"];
  sunrise = sys["sunrise"];
  sunrise += 86400;

  JsonObject weather_0 = doc["weather"][0];
  const char *icon = weather_0["icon"];
  char iconPart[3];
  icon_int = (atoi(strncpy(iconPart, icon, 2)) - 1);

  JsonObject main = doc["main"];
  temp_now = round(float(main["temp"]));
  temp_low = round(float(main["temp_min"]));
  temp_high = round(float(main["temp_max"]));
  // temp_now = round(float(111));
  // temp_low = round(float(100));
  // temp_high = round(float(1));

  return parsed;
}

union single_double {
  uint8_t two[2];
  uint16_t one;
} this_single_double;

// This draws the weather icons and temperature
void draw_weather_info(uint8_t icon, bool ab, bool hl)
{
  if (icon > 10)
    icon = 10;
  for (int yy = 0; yy < 10; yy++)
  {
    for (int xx = 0; xx < 10; xx++)
    {
      uint16_t byte_pos = (xx + icon * 10) * 2 + yy * 220;
      if (ab)
      {
        this_single_double.two[1] = weather_icons_a[byte_pos];
        this_single_double.two[0] = weather_icons_a[byte_pos + 1];
      }
      else
      {
        this_single_double.two[1] = weather_icons_b[byte_pos];
        this_single_double.two[0] = weather_icons_b[byte_pos + 1];
      }
      display.drawPixel(xx, yy + 1, this_single_double.one);
    }
  }
  drawTemp(10 + ((intLength(temp_now) < 9) ? 2 : 0), 3, temp_now, myGREEN);
  if (hl)
  {
    display.setFont(&Tiny3x3a2pt7b);
    display.setCursor(20, 3);
    display.setTextColor(myCOLOR.red(BRIGHT));
    display.print("H");
    display.setTextColor(myCOLOR.white(DIM));
    display.print("/");
    display.setTextColor(myCOLOR.blue(DIM));
    display.print("L");
    display.setFont(&Picopixel);
    drawTemp(26 - (intLength(temp_high) / 2.5), 5, temp_high, myRED);
  }
  else
  {
    display.setFont(&Tiny3x3a2pt7b);
    display.setCursor(20, 3);
    display.setTextColor(myCOLOR.red(DIM));
    display.print("H");
    display.setTextColor(myCOLOR.white(DIM));
    display.print("/");
    display.setTextColor(myCOLOR.blue(BRIGHT));
    display.print("L");
    display.setFont(&Picopixel);
    drawTemp(26 - (intLength(temp_low) / 2.5), 5, temp_low, myBLUE);
  }
}

void drawWeather()
{
  if ((icon_int < 2) && ((sunset < UTC.now()) || (sunrise > UTC.now())))
    icon_int = icon_int + 9;

  if (parsed)
    draw_weather_info(icon_int, (second() % 4 < 2), (second() % 10 < 5));

  if (weather_get_error)
    display.drawPixel(0, 0, myRED);
}

void weather_init()
{
}

void weather_loop()
{
  bool ret_code;
  unsigned long this_time = millis();

  // Update weather data every 10 minutes, if error, 5 seconds
  if (this_time > next_weather_update)
  {
    ret_code = update_weather();
    if (ret_code)
      next_weather_update = this_time + 600000;
    else
      next_weather_update = this_time + 5000;
  }
}
